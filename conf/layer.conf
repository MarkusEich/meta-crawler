## conf/layer.conf
```bitbake
# We have a conf and classes directory, append to BBPATH
BBPATH .= ":${LAYERDIR}"

# We have a recipes directory, add to BBFILES
BBFILES += "${LAYERDIR}/recipes-*/*/*.bb ${LAYERDIR}/recipes-*/*/*.bbappend ${LAYERDIR}/images/*.bb ${LAYERDIR}/recipes-*/*.bb"
BBFILE_COLLECTIONS += "meta-dfki"
BBFILE_PATTERN_meta-dfki := "^${LAYERDIR}/"
BBFILE_PRIORITY_meta-dfki = "17"

#LICENSE_PATH += "${LAYERDIR}/licenses"
```
